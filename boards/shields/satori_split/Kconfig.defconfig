## boards/shields/satori_split/Kconfig.defconfig
```kconfig
if SHIELD_SATORI_SPLIT_LEFT

config ZMK_KEYBOARD_NAME
    default "Satori Split"

config ZMK_SPLIT_ROLE_CENTRAL
    default y

config ZMK_STUDIO_LOCKING
    default n

config ZMK_STUDIO_LOCK_ON_DISCONNECT
    default n

config ZMK_USB
    default y

config BT
    default y

config ZMK_BLE
    default y

config BT_BAS
    default n

endif

if SHIELD_SATORI_SPLIT_LEFT || SHIELD_SATORI_SPLIT_RIGHT

config ZMK_SPLIT
    default y

endif
```

## boards/shields/satori_split/kconfig.shield
```kconfig
config SHIELD_SATORI_SPLIT_LEFT
    def_bool $(shields_list_contains,satori_split_left)

config SHIELD_SATORI_SPLIT_RIGHT
    def_bool $(shields_list_contains,satori_split_right)
```

## config/west.yml
```yaml
manifest:
  remotes:
    - name: zmkfirmware
      url-base: https://github.com/zmkfirmware
    - name: Thomas-Nurse
      url-base: https://github.com/Thomas-Nurse
    # Additional modules containing boards/shields/custom code can be listed here as well
    # See https://docs.zephyrproject.org/3.2.0/develop/west/manifest.html#projects
  projects:
    - name: zmk
      remote: zmkfirmware
      revision: main
      import: app/west.yml
    - name: satori-split-zmk-config
      remote: Thomas_Nurse
      revision: master
  self:
    path: config
```
